## Kconfig
```kconfig
menu "Buzzer"
  orsource "$IDF_PATH/examples/common_components/env_caps/$IDF_TARGET/Kconfig.env_caps"
  config BUZZER_PIN
    int "Buzzer Pin"
    default 46
    help
      Set Buzzer Pin
endmenu
```
